/* USER CODE BEGIN Header */
/**
  ******************************************************************************
  * @file           : main.c
  * @brief          : Main program body
  ******************************************************************************
  * @attention
  *
  * Copyright (c) 2025 STMicroelectronics.
  * All rights reserved.
  *
  * This software is licensed under terms that can be found in the LICENSE file
  * in the root directory of this software component.
  * If no LICENSE file comes with this software, it is provided AS-IS.
  *
  ******************************************************************************
  */
/* USER CODE END Header */
/* Includes ------------------------------------------------------------------*/
#include "main.h"
#include "adc.h"
#include "dac.h"
#include "dma.h"
#include "memorymap.h"
#include "tim.h"
#include "usart.h"
#include "gpio.h"

/* Private includes ----------------------------------------------------------*/
/* USER CODE BEGIN Includes */
#include "AD9910.h"
#include "tjc_usart_hmi.h"
#include <stdio.h>
#include <stdlib.h>
#include <string.h>
#include "arm_math.h"
#include "math.h"
#include "arm_const_structs.h"
/* USER CODE END Includes */

/* Private typedef -----------------------------------------------------------*/
/* USER CODE BEGIN PTD */

/* USER CODE END PTD */

/* Private define ------------------------------------------------------------*/
/* USER CODE BEGIN PD */
#define FRAME_LENGTH 2
#define FFT_LEN 2048    


/* USER CODE END PD */

/* Private macro -------------------------------------------------------------*/
/* USER CODE BEGIN PM */

/* USER CODE END PM */

/* Private variables ---------------------------------------------------------*/

/* USER CODE BEGIN PV */
float Fre_respon[30]=
{
0.9865,
0.9488,
0.8944,
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0.1684,
0.1612
};



/* USER CODE END PV */

/* Private function prototypes -----------------------------------------------*/
void SystemClock_Config(void);
void PeriphCommonClock_Config(void);
static void MPU_Config(void);
/* USER CODE BEGIN PFP */
static float si_10000[10000] = {
0.00000000, 0.00031419, 0.00062838, 0.00094257, 0.00125676, 0.00157095, 0.00188514, 0.00219933, 0.00251351, 0.00282770, 0.00314189, 0.00345607,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 0.03108482, 
0.03139840, 0.03171196, 0.03202551, 0.03233905, 0.03265258, 0.03296609, 0.03327959, 0.03359308, 0.03390655, 0.03422001, 0.03453346, 0.03484689,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 0.06236113, 
0.06267285, 0.06298455, 0.06329623, 0.06360788, 0.06391950, 0.06423110, 0.06454268, 0.06485423, 0.06516575, 0.06547725, 0.06578872, 0.06610017,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 0.09339127, 
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-0.03108482, -0.03077123, -0.03045763, -0.03014402, -0.02983039, -0.02951675, -0.02920310, -0.02888944, -0.02857577, -0.02826209, -0.02794840, -0.02763469,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 -0.00000000  
};
/* USER CODE END PFP */

/* Private user code ---------------------------------------------------------*/
/* USER CODE BEGIN 0 */


char frev[10];//串口屏幕获得
volatile unsigned char frev2[8];//串口屏幕获得
volatile uint16_t fre;
volatile uint32_t fre2;
volatile uint16_t f;//Fre zi
volatile uint8_t AD_flag = 0;
volatile uint8_t AD_flag2 = 0;
volatile uint8_t DA_flag = 0;
float va;
uint16_t AD_value[10000];
uint16_t AD_value2[10000];
uint16_t AD_valuefft[2048];
uint16_t DA_value[10000];
uint16_t DA_set[2000];
float Fre_v[5001];
float Fre_p[5001];
float Fre_s[5001];
float Fre_c[5001];
float frequency;
uint16_t count_max;
float fs;

volatile _Bool halflag=0;
volatile _Bool comflag=0;

float  FFT_INPUT [FFT_LEN *2];   //fft输入数组 ，大小是二倍的点数

float FFT_OUTPUT[FFT_LEN];  ///fft输出数组

float adc_value[FFT_LEN];  /// adc读取数组


uint16_t rise_cut=0;
uint16_t fall_cut=0;
uint8_t cut_count = 0;
uint16_t maxindex=2;
uint16_t minindex=2;

//串口指令
void get() {
		uint8_t index;
		fre = 0;
		va=0;
		for (int i = 0; i < 10; i++) 
		{
				if(frev[i]==0x01)
				{
					index=i;
					break;
				}
		}
		for (int i = 1; i < index; i++) 
		{
				fre = fre * 10 + (frev[i] - '0');
		}
		va=(float)(frev[index+1]- '0')*1.0f+(float)(frev[index+3]- '0')/10.0f;
 
}

void get2() 
{
    uint8_t index = 0xFF;  // 初始为非法值
    fre2 = 0;              // fre2 清零

    for (int i = 0; i < 8; i++) 
    {
        if (frev2[i] == 0xFF) 
        {
            index = i;
            break;
        }
    }

    if (index != 0xFF)  // 找到0xFF
    {
        for (int i = 0; i < index; i++) 
        {
            fre2 = fre2 * 10 + (frev2[i] - '0');
        }
    }
    else
    {
        // 错误处理：没有找到0xFF
        fre2 = 0;
    }
}

void detect_filter(uint16_t size)
{
    float threshold = 0.707f;  // -3dB点
//    uint16_t rise_cut = 0, fall_cut = 0;
//    uint8_t cut_count = 0;

    // 找到拐点
    for (uint16_t i = 2; i < size; i++)
    {
			 if(Fre_v[i]>Fre_v[maxindex])
			 {
				 maxindex=i;
			 }
			 if(Fre_v[i]<Fre_v[minindex])
			 {
				 minindex=i;
			 }
        if (Fre_v[i - 1] >= threshold && Fre_v[i] < threshold)
        {
            fall_cut = i;
            cut_count++;
        }
        if (Fre_v[i - 1] <= threshold && Fre_v[i] > threshold)
        {
            rise_cut = i;
            cut_count++;
        }
    }

    if (cut_count == 2)
    {
        // 检查rise_cut和fall_cut之间是否一直高于threshold
        uint8_t is_bandpass = 1;
			if(rise_cut<fall_cut)
			{
        for (uint16_t i = rise_cut + 1; i < fall_cut; i++)
        {
            if (Fre_v[i] < threshold)
            {
                is_bandpass = 0;
                break;
            }
        }
			}
			else
			{
				is_bandpass = 0;
				for (uint16_t i = fall_cut + 1; i < rise_cut; i++)
        {
            if (Fre_v[i] > threshold)
            {
                is_bandpass = 1;
                break;
            }
        }
			}
        if (is_bandpass)
        {
            tjc_send_txt("t5", "txt", "band pass");
        }
        else
        {
            tjc_send_txt("t5", "txt", "band stop");
        }
    }
    else if (cut_count == 1)
    {
        if (rise_cut == 0)
        {
            tjc_send_txt("t5", "txt", "low pass");
        }
        else if (fall_cut == 0)
        {
            tjc_send_txt("t5", "txt", "high pass");
        }
    }
    else
    {
			if((maxindex-minindex)>4000&&maxindex>minindex)
			{
				tjc_send_txt("t5", "txt", "high pass");
			}
			else
				tjc_send_txt("t5", "txt", "Unknown");
    }
}

//单位 Khz
void Set_SampleRate(TIM_TypeDef *timer, uint32_t target_freq) {
    uint32_t timer_clk = 240000;  // 240MHz
    uint32_t psc;
//		__HAL_TIM_DISABLE(&htim4);  // 可选，防止CNT正好在边界

		__HAL_TIM_SET_COUNTER(&htim4, 0);  // CNT清零（可选，看需求）
    if (target_freq == 0) return;  // 防止除0错误

    // 计算ARR重装数
    psc = (timer_clk / target_freq) - 1;

    // 限制ARR合法范围 (16位定时器最大65535)
    if (psc > 0xFFFF) psc = 0xFFFF;
		TIM4->ARR=psc;


//		TIM4->EGR = TIM_EGR_UG;  // 触发更新事件，让ARR和PSC立即生效

//		__HAL_TIM_ENABLE(&htim4);  // 可选，重新启用
}


void dftphase(int fre)
{
	float s1;
	float c1;
	float s1q;
	float c1q;
	float v1,v1q;
	uint16_t fc1=2500;
	uint16_t f1=0;
	s1=0;
	c1=0;
	s1q=0;
	c1q=0;
	float p1,p1q;
	 for (int i=0;i<10000;i++)   
    {
        s1+=(float)AD_value[i]*si_10000[f1];
        c1+=(float)AD_value[i]*si_10000[fc1];
			  s1q+=(float)AD_value2[i]*si_10000[f1];
        c1q+=(float)AD_value2[i]*si_10000[fc1];
        f1+=fre;
				fc1+=fre;
        if (f1>=10000)
        {
            f1-=10000;
        }       
        if (fc1>=10000)
        {
            fc1-=10000;
        }
		}
//	s1/=2500.0f;
//	c1/=2500.0f;
//	s1q/=2500.0f;
//	c1q/=2500.0f;
		v1q=s1q*s1q+c1q*c1q;
		Fre_c[fre]=(c1*c1q+s1*s1q)/v1q;
		Fre_s[fre]=(s1q*c1-s1*c1q)/v1q;
		Fre_v[fre]=sqrtf(Fre_c[fre]*Fre_c[fre]+Fre_s[fre]*Fre_s[fre]);
//		Fre_v[fre]=sqrtf(Fre_c[fre]*Fre_c[fre]*v1q+Fre_s[fre]*Fre_s[fre]*v1q);
}

//扫频，幅频特性
void sweep()
{
	uint32_t fre;
	AD9910_AmpWrite(6000);

	for(int i = 0; i <5001; i++)
	{
		fre = i * 200;
		AD9910_FreWrite(fre);
//		HAL_Delay(1);
		AD_flag = 0;  // 先清零
		AD_flag2=0;
		Set_SampleRate(TIM4,2000);//1000khz
		HAL_ADC_Start_DMA(&hadc1, (uint32_t*)AD_value,10000);
		HAL_ADC_Start_DMA(&hadc2, (uint32_t*)AD_value2,10000);
		HAL_TIM_Base_Start(&htim4);
		while(AD_flag == 0&&AD_flag2==0);  
//		Fre_v[i]=calculate_amplitude();
		dftphase(i);
		printf("add s0.id,16,%d\xff\xff\xff",(int)(Fre_v[i]*256) );
		printf("add s1.id,17,%d\xff\xff\xff",(int)(atanf(Fre_s[i]/Fre_c[i])/3.14159)*128+128 );
	}
	detect_filter(5001);
	tjc_send_txt("t8", "txt", "Success!");
}





float s[20], c[20];
float prev_phase[20] = {0};
float f_step[20];
float freq_error_acc[20] = {0};

void dft()
{
    // DFT前缀初始化
		uint16_t f_idx[20] ;     // 正弦索引
		uint16_t fc_idx[20] ; // 余弦索引
		uint16_t f_step[20]; 
	    for (int n = 0; n < 20; n++)
    {
			s[n]=0;
			c[n]=0;
      f_idx[n] = 0;
      fc_idx[n] = 2500;
    }
       // 每次谐波的步进
	
    // 步进因子初始化
    for (int n = 0; n < 20; n++)
    {
        f_step[n] = f * (n + 1) + (n + 1) * 5;
    }

    // === DFT计算 ===
    for (int i = 0; i < 10000; i++)
    {
        for (int n = 0; n < 20; n++)
        {
            s[n] += (float)AD_value[i] * si_10000[f_idx[n]];
            c[n] += (float)AD_value[i] * si_10000[fc_idx[n]];

            f_idx[n] += f_step[n];
            fc_idx[n] += f_step[n];

            if (f_idx[n] >= 10000) f_idx[n] -= 10000;
            if (fc_idx[n] >= 10000) fc_idx[n] -= 10000;
        }
    }
		
		for (int n = 0; n < 20; n++)
    {
        s[n] /= 1250.0f;
        c[n] /= 1250.0f;
				if (s[n]*s[n]+c[n]*c[n]<20.0)
				{
					s[n]=0;
					c[n]=0;
				}
    }
    float Kp = 0.005;  // 锁相增益（可调）
    for (int n = 0; n < 20; n++)
    {
//        s[n] /= 1250.0f;
//        c[n] /= 1250.0f;

        float phase = atan2f(s[n], c[n]);
        float delta_phase = phase - prev_phase[n];
				if(delta_phase<(3.14159f/100.0f))
				{
					Kp = 0.0005;
				}
				if(delta_phase<(3.14159f/1000.0f))
				{
					Kp = 0.00001;
				}
        // 处理相位跳变
        if (delta_phase > 3.14159f) delta_phase -= 6.28318f;
        if (delta_phase < -3.14159f) delta_phase += 6.28318f;

        prev_phase[n] = phase;
				f_idx[n] += Kp * delta_phase/3.14159f*5000.0f;
				fc_idx[n]+= Kp * delta_phase/3.14159f*5000.0f;
//				f_step[n]+= Kp * delta_phase*500/3.14159f/f;
				        // 限幅
        if (f_step[n] < n  * f) 		f_step[n] = (n + 1) * f;
        if (f_step[n] > (n + 2) *f) f_step[n] = (n + 1) * f;
		}
        // === 累加频率误差到 f_step ===
//    for (int n = 0; n < 20; n++)
//    {
//        
//    }


    // === 重构信号 ===
    for (int i = 0; i < 10000; i++)
    {
        float sum = 0;
        for (int n = 0; n < 20; n++)
        {
            sum += (s[n] * Fre_c[f_step[n]] - c[n] * Fre_s[f_step[n]]) * si_10000[f_idx[n]];
            sum += (c[n] * Fre_c[f_step[n]] + s[n] * Fre_s[f_step[n]]) * si_10000[fc_idx[n]];
					

            f_idx[n] += f_step[n];
            fc_idx[n] += f_step[n];

            if (f_idx[n] >= 10000) f_idx[n] -= 10000;
            if (fc_idx[n] >= 10000) fc_idx[n] -= 10000;
        }
        DA_value[i] = 2048 + sum;
    }
}

uint16_t fft()
{
//		HAL_Delay(5);
		Set_SampleRate(TIM4,410);//arr 293-1
		HAL_TIM_Base_Start(&htim4);
		HAL_ADC_Start_DMA(&hadc1, (uint32_t*)AD_valuefft, FFT_LEN);
		while(AD_flag == 0);
		float fs=240000000.0f/(TIM4->ARR+1); 
		float value_max = 0;

	  for (int i = 0; i < FFT_LEN; i++) 
        {
             FFT_INPUT[2 * i] =(float)AD_valuefft[i]/4096.0f*3.3f;       // shi bu
             FFT_INPUT[2 * i + 1] = 0;              // xu  bu
        }
        //////////////////FFT计算
				arm_cfft_f32(&arm_cfft_sR_f32_len2048, FFT_INPUT, 0, 1);
				arm_cmplx_mag_f32(FFT_INPUT, FFT_OUTPUT, FFT_LEN);

        //FFT后的第一个赋值很大，最好跳过，
        for(int j=1 ;j<300;j++)
        {
            if(value_max<FFT_OUTPUT[j])
            {
                count_max = j;
                value_max = FFT_OUTPUT[j];
            }
        }
		 fre = fs*(count_max*1.0f)/(FFT_LEN*1.0f);
		 f=(uint16_t)((fre/200.0f+0.5f)-5.0f);
		 return f;
}


/* USER CODE END 0 */

/**
  * @brief  The application entry point.
  * @retval int
  */
int main(void)
{

  /* USER CODE BEGIN 1 */

  /* USER CODE END 1 */

  /* MPU Configuration--------------------------------------------------------*/
  MPU_Config();

  /* MCU Configuration--------------------------------------------------------*/

  /* Reset of all peripherals, Initializes the Flash interface and the Systick. */
  HAL_Init();

  /* USER CODE BEGIN Init */

  /* USER CODE END Init */

  /* Configure the system clock */
  SystemClock_Config();

  /* Configure the peripherals common clocks */
  PeriphCommonClock_Config();

  /* USER CODE BEGIN SysInit */

  /* USER CODE END SysInit */

  /* Initialize all configured peripherals */
  MX_GPIO_Init();
  MX_DMA_Init();
  MX_ADC1_Init();
  MX_DAC1_Init();
  MX_TIM6_Init();
  MX_USART1_UART_Init();
  MX_ADC2_Init();
  MX_TIM4_Init();
  /* USER CODE BEGIN 2 */
	Init_AD9910();
	initRingBuffer();
//	HAL_ADC_Start_DMA(&hadc1,(uint32_t*)AD_value,10000);
	HAL_UART_Receive_IT(&TJC_UART, RxBuffer, 1);
	tjc_send_txt("t8", "txt", " ");
	tjc_send_txt("t5", "txt", " ");
  /* USER CODE END 2 */

  /* Infinite loop */
  /* USER CODE BEGIN WHILE */
  while (1)
  {
    /* USER CODE END WHILE */

    /* USER CODE BEGIN 3 */
//		tjc_send_txt("t7", "txt", "S");

			while (usize >= 12)
				{
					// 校验帧头帧尾是否匹配
					if (u(0) == 0x03)
					{
						// 匹配，进行解析
						for(int i=0;i<10;i++)
						{
							frev[i]=u(i);
						}
						get();
						AD9910_FreWrite(fre);
						AD9910_AmpWrite((uint16_t)(va/Fre_respon[(fre/100)-1]/4.0f/5.0f/0.8f*16383));				
						udelete(13); // 删除解析过的数据
					} 
					else if(u(0)==0xff)
					{
						for(int i=1;i<9;i++)
						{
							frev2[i-1]=u(i);
						}
							get2();
							AD9910_FreWrite(fre2);
							AD9910_AmpWrite(9000);			
							udelete(16); // 删除解析过的数据
					}
					else if( u(0) == 0x05)
					{
						if(u(1) == 0x66)
						{
							tjc_send_txt("t8", "txt", "... ");
							tjc_send_txt("t5", "txt", "  ");
							sweep();
						}
						if((u(1) == 0x99))
						{
							while(1)
							{
							HAL_GPIO_WritePin(Contr_GPIO_Port,Contr_Pin,GPIO_PIN_SET);
							HAL_Delay(2);
							while(1)
							{
								f=fft();
								f=fft();
								Set_SampleRate(TIM4,2000);
								HAL_TIM_Base_Start(&htim4);
								HAL_ADC_Start_DMA(&hadc1, (uint32_t*)AD_value, 10000);
	//							while(AD_flag == 0);  
								dft();
	//							DA_flag=1;
								for(int i=0;i<10000;i++)
								{
									DA_set[i]=DA_value[i];
								}
									HAL_TIM_Base_Start(&htim6);
									HAL_DAC_Start_DMA(&hdac1,DAC_CHANNEL_2,(uint32_t*)DA_value,10000,DAC_ALIGN_12B_R);
								while(!(halflag&&comflag));
									HAL_ADC_Start_DMA(&hadc1, (uint32_t*)AD_value, 10000);
									HAL_TIM_Base_Start(&htim4);
									while(AD_flag == 0);
									dft();
									halflag=comflag=0;
								}
							}
						udelete(2);
					}
					else
					{
						// 不匹配删除1字节
						udelete(1);
						break;
					}
				}
			}
	
	}
  /* USER CODE END 3 */
}

/**
  * @brief System Clock Configuration
  * @retval None
  */
void SystemClock_Config(void)
{
  RCC_OscInitTypeDef RCC_OscInitStruct = {0};
  RCC_ClkInitTypeDef RCC_ClkInitStruct = {0};

  /** Supply configuration update enable
  */
  HAL_PWREx_ConfigSupply(PWR_LDO_SUPPLY);

  /** Configure the main internal regulator output voltage
  */
  __HAL_PWR_VOLTAGESCALING_CONFIG(PWR_REGULATOR_VOLTAGE_SCALE0);

  while(!__HAL_PWR_GET_FLAG(PWR_FLAG_VOSRDY)) {}

  /** Initializes the RCC Oscillators according to the specified parameters
  * in the RCC_OscInitTypeDef structure.
  */
  RCC_OscInitStruct.OscillatorType = RCC_OSCILLATORTYPE_HSE;
  RCC_OscInitStruct.HSEState = RCC_HSE_ON;
  RCC_OscInitStruct.PLL.PLLState = RCC_PLL_ON;
  RCC_OscInitStruct.PLL.PLLSource = RCC_PLLSOURCE_HSE;
  RCC_OscInitStruct.PLL.PLLM = 5;
  RCC_OscInitStruct.PLL.PLLN = 192;
  RCC_OscInitStruct.PLL.PLLP = 2;
  RCC_OscInitStruct.PLL.PLLQ = 2;
  RCC_OscInitStruct.PLL.PLLR = 2;
  RCC_OscInitStruct.PLL.PLLRGE = RCC_PLL1VCIRANGE_2;
  RCC_OscInitStruct.PLL.PLLVCOSEL = RCC_PLL1VCOWIDE;
  RCC_OscInitStruct.PLL.PLLFRACN = 0;
  if (HAL_RCC_OscConfig(&RCC_OscInitStruct) != HAL_OK)
  {
    Error_Handler();
  }

  /** Initializes the CPU, AHB and APB buses clocks
  */
  RCC_ClkInitStruct.ClockType = RCC_CLOCKTYPE_HCLK|RCC_CLOCKTYPE_SYSCLK
                              |RCC_CLOCKTYPE_PCLK1|RCC_CLOCKTYPE_PCLK2
                              |RCC_CLOCKTYPE_D3PCLK1|RCC_CLOCKTYPE_D1PCLK1;
  RCC_ClkInitStruct.SYSCLKSource = RCC_SYSCLKSOURCE_PLLCLK;
  RCC_ClkInitStruct.SYSCLKDivider = RCC_SYSCLK_DIV1;
  RCC_ClkInitStruct.AHBCLKDivider = RCC_HCLK_DIV2;
  RCC_ClkInitStruct.APB3CLKDivider = RCC_APB3_DIV2;
  RCC_ClkInitStruct.APB1CLKDivider = RCC_APB1_DIV2;
  RCC_ClkInitStruct.APB2CLKDivider = RCC_APB2_DIV2;
  RCC_ClkInitStruct.APB4CLKDivider = RCC_APB4_DIV2;

  if (HAL_RCC_ClockConfig(&RCC_ClkInitStruct, FLASH_LATENCY_4) != HAL_OK)
  {
    Error_Handler();
  }
}

/**
  * @brief Peripherals Common Clock Configuration
  * @retval None
  */
void PeriphCommonClock_Config(void)
{
  RCC_PeriphCLKInitTypeDef PeriphClkInitStruct = {0};

  /** Initializes the peripherals clock
  */
  PeriphClkInitStruct.PeriphClockSelection = RCC_PERIPHCLK_ADC;
  PeriphClkInitStruct.PLL2.PLL2M = 25;
  PeriphClkInitStruct.PLL2.PLL2N = 500;
  PeriphClkInitStruct.PLL2.PLL2P = 10;
  PeriphClkInitStruct.PLL2.PLL2Q = 2;
  PeriphClkInitStruct.PLL2.PLL2R = 2;
  PeriphClkInitStruct.PLL2.PLL2RGE = RCC_PLL2VCIRANGE_0;
  PeriphClkInitStruct.PLL2.PLL2VCOSEL = RCC_PLL2VCOWIDE;
  PeriphClkInitStruct.PLL2.PLL2FRACN = 0;
  PeriphClkInitStruct.AdcClockSelection = RCC_ADCCLKSOURCE_PLL2;
  if (HAL_RCCEx_PeriphCLKConfig(&PeriphClkInitStruct) != HAL_OK)
  {
    Error_Handler();
  }
}

/* USER CODE BEGIN 4 */
void HAL_ADC_ConvCpltCallback(ADC_HandleTypeDef *hadc)
{
	if(hadc->Instance == ADC1)
	{
		AD_flag=1;
		HAL_TIM_Base_Stop(&htim4);
		HAL_ADC_Stop_DMA(&hadc1);
	}
	if(hadc->Instance == ADC2)
	{
		AD_flag2=1;
		HAL_ADC_Stop_DMA(&hadc2);
	}
}
/* USER CODE END 4 */

 /* MPU Configuration */

void MPU_Config(void)
{
  MPU_Region_InitTypeDef MPU_InitStruct = {0};

  /* Disables the MPU */
  HAL_MPU_Disable();

  /** Initializes and configures the Region and the memory to be protected
  */
  MPU_InitStruct.Enable = MPU_REGION_ENABLE;
  MPU_InitStruct.Number = MPU_REGION_NUMBER0;
  MPU_InitStruct.BaseAddress = 0x0;
  MPU_InitStruct.Size = MPU_REGION_SIZE_4GB;
  MPU_InitStruct.SubRegionDisable = 0x87;
  MPU_InitStruct.TypeExtField = MPU_TEX_LEVEL0;
  MPU_InitStruct.AccessPermission = MPU_REGION_NO_ACCESS;
  MPU_InitStruct.DisableExec = MPU_INSTRUCTION_ACCESS_DISABLE;
  MPU_InitStruct.IsShareable = MPU_ACCESS_SHAREABLE;
  MPU_InitStruct.IsCacheable = MPU_ACCESS_NOT_CACHEABLE;
  MPU_InitStruct.IsBufferable = MPU_ACCESS_NOT_BUFFERABLE;

  HAL_MPU_ConfigRegion(&MPU_InitStruct);
  /* Enables the MPU */
  HAL_MPU_Enable(MPU_PRIVILEGED_DEFAULT);

}

/**
  * @brief  This function is executed in case of error occurrence.
  * @retval None
  */
void Error_Handler(void)
{
  /* USER CODE BEGIN Error_Handler_Debug */
  /* User can add his own implementation to report the HAL error return state */
  __disable_irq();
  while (1)
  {
  }
  /* USER CODE END Error_Handler_Debug */
}

#ifdef  USE_FULL_ASSERT
/**
  * @brief  Reports the name of the source file and the source line number
  *         where the assert_param error has occurred.
  * @param  file: pointer to the source file name
  * @param  line: assert_param error line source number
  * @retval None
  */
void assert_failed(uint8_t *file, uint32_t line)
{
  /* USER CODE BEGIN 6 */
  /* User can add his own implementation to report the file name and line number,
     ex: printf("Wrong parameters value: file %s on line %d\r\n", file, line) */
  /* USER CODE END 6 */
}
#endif /* USE_FULL_ASSERT */
